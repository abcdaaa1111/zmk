/*
 * Copyright (c) 2025
 * SPDX-License-Identifier: MIT
 *
 * Test keymap for SF32LB52-DevKit-LCD
 * KEY1 -> A, KEY2 -> B
 */

#include <behaviors.dtsi>
#include <dt-bindings/zmk/keys.h>
#include <dt-bindings/zmk/bt.h>

/ {
    keymap {
        compatible = "zmk,keymap";

        default_layer {
            bindings = <
                &kp B  &bt BT_CLR
            >;
        };
    };
};
