## app/boards/shields/sf32lb52_split_test/Kconfig.defconfig
```kconfig
if SHIELD_SF32LB52_SPLIT_TEST_LEFT

config ZMK_KEYBOARD_NAME
	default "SF32LB52 Split"

config ZMK_SPLIT_ROLE_CENTRAL
	default y

config ZMK_STUDIO
	default y

endif

if SHIELD_SF32LB52_SPLIT_TEST_LEFT || SHIELD_SF32LB52_SPLIT_TEST_RIGHT

config ZMK_SPLIT
	default y

endif
```

## app/boards/shields/sf32lb52_split_test/Kconfig.shield
```kconfig
config SHIELD_SF32LB52_SPLIT_TEST_LEFT
	def_bool $(shields_list_contains,sf32lb52_split_test_left)

config SHIELD_SF32LB52_SPLIT_TEST_RIGHT
	def_bool $(shields_list_contains,sf32lb52_split_test_right)
```

## app/boards/shields/sf32lb52_test/Kconfig.defconfig
```kconfig
# Copyright (c) 2025
# SPDX-License-Identifier: MIT

if SHIELD_SF32LB52_TEST

config ZMK_KEYBOARD_NAME
	default "SF32LB52 Test"

endif
```

## app/boards/shields/sf32lb52_test/Kconfig.shield
```kconfig
# Copyright (c) 2025
# SPDX-License-Identifier: MIT

config SHIELD_SF32LB52_TEST
	def_bool $(shields_list_contains,sf32lb52_test)
```

## app/boards/shields/sf32lb52_zmkstudio_test/Kconfig.defconfig
```kconfig
if SHIELD_SF32LB52_ZMKSTUDIO_TEST

config ZMK_KEYBOARD_NAME
	default "SF32LB52 Studio"

config ZMK_STUDIO
	default y

endif
```

## app/boards/shields/sf32lb52_zmkstudio_test/Kconfig.shield
```kconfig
config SHIELD_SF32LB52_ZMKSTUDIO_TEST
	def_bool $(shields_list_contains,sf32lb52_zmkstudio_test)
```

## app/boards/shields/urchin_sf32lb52/Kconfig.defconfig
```kconfig
if SHIELD_URCHIN_SF32LB52_LEFT

config ZMK_KEYBOARD_NAME
	default "Urchin SF32LB52"

config ZMK_SPLIT_ROLE_CENTRAL
	default y

config ZMK_STUDIO
	default y

endif

if SHIELD_URCHIN_SF32LB52_LEFT || SHIELD_URCHIN_SF32LB52_RIGHT

config ZMK_SPLIT
	default y

endif
```

## app/boards/shields/urchin_sf32lb52/Kconfig.shield
```kconfig
config SHIELD_URCHIN_SF32LB52_LEFT
	def_bool $(shields_list_contains,urchin_sf32lb52_left)

config SHIELD_URCHIN_SF32LB52_RIGHT
	def_bool $(shields_list_contains,urchin_sf32lb52_right)
```

## app/boards/sifli/sf32lb52_devkit_lcd/board.yml
```yaml
# Copyright (c) 2025
# SPDX-License-Identifier: MIT

board:
  extend: sf32lb52_devkit_lcd
  variants:
    - name: zmk
      qualifier: sf32lb525uc6
```

## app/boards/sifli/sf32lb52_devkit_lcd/sf32lb52_devkit_lcd_sf32lb525uc6_zmk_defconfig
```kconfig
# Copyright (c) 2025
# SPDX-License-Identifier: MIT

CONFIG_ARM_MPU=y
CONFIG_HW_STACK_PROTECTION=y

CONFIG_GPIO=y
CONFIG_SERIAL=y
CONFIG_CONSOLE=y
CONFIG_UART_CONSOLE=y

CONFIG_ZMK_BLE=y

CONFIG_ZMK_USB_CHERRYUSB=y
CONFIG_CHERRYUSB_DEVICE_MUSB_SIFLI=y
CONFIG_CHERRYUSB_DEV_BASE_ADDR=0x50047000

CONFIG_LOG=y
CONFIG_LOG_DEFAULT_LEVEL=4
CONFIG_BT_LOG_LEVEL_DBG=y
CONFIG_LOG_RATELIMIT=n
CONFIG_LOG_RATELIMIT_FALLBACK_LOG=y
CONFIG_LOG_BUFFER_SIZE=65536
CONFIG_BT_RX_STACK_SIZE=4096
CONFIG_THREAD_NAME=y
CONFIG_THREAD_ANALYZER=y
CONFIG_THREAD_ANALYZER_AUTO=y
CONFIG_THREAD_ANALYZER_AUTO_INTERVAL=5
CONFIG_THREAD_ANALYZER_USE_LOG=y
CONFIG_LOG_BLOCK_IN_THREAD=y
```

## app/module/dts/bindings/kscan/kscan.yaml
```yaml
# Copyright (c) 2019 Intel Corporation
# SPDX-License-Identifier: Apache-2.0
#
# Base binding for kscan devices (restored for ZMK compatibility).

description: Base KSCAN node

compatible: "kscan"

properties:
  label:
    type: string
    required: false
    deprecated: true
```
